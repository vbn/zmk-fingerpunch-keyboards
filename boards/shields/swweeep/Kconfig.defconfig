## boards/shields/swweeep/Kconfig.defconfig
```kconfig
# Copyright (c) 2022 The ZMK Contributors
# SPDX-License-Identifier: MIT

if SHIELD_SWWEEEP_LEFT_CENTRAL || SHIELD_SWWEEEP_DONGLE

config ZMK_KEYBOARD_NAME
    default "swweeep"

config ZMK_SPLIT_ROLE_CENTRAL
    default y

endif

if SHIELD_SWWEEEP_DONGLE
if ZMK_DISPLAY

config I2C
    default y

config SSD1306
    default y

config LV_Z_VDB_SIZE
    default 64

config LV_DPI_DEF
    default 148

config LV_Z_BITS_PER_PIXEL
    default 1

choice LV_COLOR_DEPTH
    default LV_COLOR_DEPTH_1
endchoice

endif
endif

if SHIELD_SWWEEEP_LEFT || SHIELD_SWWEEEP_RIGHT || SHIELD_SWWEEEP_LEFT_CENTRAL || SHIELD_SWWEEEP_DONGLE
config ZMK_SPLIT
    default y
endif
```
