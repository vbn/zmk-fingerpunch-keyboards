/ {
    esb_split {
        compatible = "zmk,esb-split";
        /* Example of custom addresses */
        base-addr-0 = <0xAA 0xBB 0xCC 0xDD>;
        base-addr-1 = <0x11 0x22 0x33 0x44>;
        addr-prefix = <0xAA 0x11 0x22 0x33 0x44 0x55 0x66 0x77>;
    };
};